## dts/bindings/haptic/ti,drv2605.yaml
```yaml
description: TI DRV2605L Haptic Motor Controller

compatible: "ti,drv2605"

include: i2c-device.yaml

properties:
  actuator-type:
    type: string
    default: "lra"
    enum:
      - "lra"
      - "erm"
    description: |
      Actuator type. "lra" selects the internal LRA library and feedback
      control mode (closed-loop). "erm" selects the ERM (eccentric rotating
      mass) library.

  rated-voltage-mv:
    type: int
    default: 2000
    description: |
      Rated voltage of the actuator in millivolts (RMS for LRA, DC for ERM).
      Used to compute the RATED_VOLTAGE register value. Default 2000 mV
      matches the Vybronics VG1040003D LRA.

  overdrive-voltage-mv:
    type: int
    default: 2400
    description: |
      Overdrive (clamp) voltage in millivolts. Determines maximum drive
      voltage during effect playback. Should be at most the actuator's
      absolute maximum rating. Default 2400 mV.

  library:
    type: int
    default: 6
    description: |
      Built-in effect library to select (register 0x21). For LRAs use 6.
      For ERMs valid values are 1-5 selecting library A-E.
```

## dts/bindings/input/azoteq,iqs9151.yaml
```yaml
description: |
  Azoteq IQS9151 driver placeholder.

compatible: "azoteq,iqs9151"

include: i2c-device.yaml

properties:
  irq-gpios:
    type: phandle-array
    required: true
    description: Interrupt GPIO for IQS9151 driver.

  haptic-dev:
    type: phandle
    description: |
      Optional DRV2605L haptic motor controller used for tactile feedback
      on gesture events (tap confirmation, long-press hold engagement,
      drag-lock arm/release). If omitted, haptic feedback is disabled at
      runtime even when CONFIG_INPUT_IQS9151_HAPTIC_FEEDBACK_ENABLE=y.

  fsr-click-dev:
    type: phandle
    description: |
      Optional FSR click detector phandle (zmk,fsr-click compatible device).
      When present and CONFIG_INPUT_FSR_CLICK is enabled, the 2F scroll/pinch
      transition is suppressed while the FSR reports a press. This allows
      dragging to continue uninterrupted when a second finger is placed on the
      trackpad during an FSR-held drag.
```

## dts/bindings/input/zmk,fsr-click.yaml
```yaml
description: |
  ZMK FSR (Force Sensitive Resistor) click detector via ADS1015 I2C ADC.

  Polls an ADC channel connected to an FSR voltage divider and emits
  INPUT_BTN_0 press/release events into the ZMK input subsystem.

  Typical wiring (right side, I2C bus shared with IQS9151 and DRV2605L):
    FSR+ → 3V3
    FSR- → ADS1015 A0 and 47kΩ pull-down to GND
    ADS1015 SDA/SCL → XIAO D4/D5
    ADS1015 ADDR → GND (I2C address 0x48)

compatible: "zmk,fsr-click"

properties:
  io-channels:
    type: phandle-array
    required: true
    description: |
      ADC channel connected to the FSR voltage divider output.
      Example: <&ads1015 0> for ADS1015 channel 0 (AIN0).

  haptic-dev:
    type: phandle
    required: false
    description: |
      Optional DRV2605L haptic device phandle. When present and
      CONFIG_INPUT_FSR_CLICK_HAPTIC_GATE is enabled, FSR readings are
      suppressed while the DRV2605L is playing and for haptic-gate-ms
      afterward, preventing vibration-induced false clicks.

  threshold-delta:
    type: int
    default: 50
    description: |
      ADC raw counts above the calibrated resting baseline that trigger
      a BTN_0 press. ADS1015 at gain 1x (FSR ±4.096V) gives ~2 mV/count,
      so 50 counts ≈ 100 mV. Increase if idle noise causes false presses;
      decrease if heavy presses are not detected.

  poll-interval-ms:
    type: int
    default: 5
    description: FSR polling interval in milliseconds.

  haptic-gate-ms:
    type: int
    default: 200
    description: |
      Duration in milliseconds to suppress FSR readings after the
      DRV2605L GO bit clears. Accounts for residual LRA vibration
      after the waveform finishes. Only used when haptic-dev is set.
```
